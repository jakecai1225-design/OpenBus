AUTOSAR XML
package /Ecuc_CanIf
  module config ActiveEcuC
    CanIf
      CanIfPublicCfg
        14 x ecuc boolean param value, all with value=false:
          CanIfPublicDevErrorDetect: definition=/AUTOSAR/EcucDefs/CanIf/CanIfPublicCfg/CanIfPublicDevErrorDetect
          CanIfPublicMultipleDrvSupport: definition=/AUTOSAR/EcucDefs/CanIf/CanIfPublicCfg/CanIfPublicMultipleDrvSupport
          CanIfPublicPnSupport: definition=/AUTOSAR/EcucDefs/CanIf/CanIfPublicCfg/CanIfPublicPnSupport
          CanIfPublicTxBuffering: definition=/AUTOSAR/EcucDefs/CanIf/CanIfPublicCfg/CanIfPublicTxBuffering
          CanIfPublicWakeupCheckValidSupport: definition=/AUTOSAR/EcucDefs/CanIf/CanIfPublicCfg/CanIfPublicWakeupCheckValidSupport
          CanIfPublicCancelTransmitSupport: definition=/AUTOSAR/EcucDefs/CanIf/CanIfPublicCfg/CanIfPublicCancelTransmitSupport
          CanIfPublicReadRxPduDataApi: definition=/AUTOSAR/EcucDefs/CanIf/CanIfPublicCfg/CanIfPublicReadRxPduDataApi
          CanIfPublicReadRxPduNotifyStatusApi: definition=/AUTOSAR/EcucDefs/CanIf/CanIfPublicCfg/CanIfPublicReadRxPduNotifyStatusApi
          CanIfPublicReadTxPduNotifyStatusApi: definition=/AUTOSAR/EcucDefs/CanIf/CanIfPublicCfg/CanIfPublicReadTxPduNotifyStatusApi
          CanIfPublicSetDynamicTxIdApi: definition=/AUTOSAR/EcucDefs/CanIf/CanIfPublicCfg/CanIfPublicSetDynamicTxIdApi
          CanIfPublicTxConfirmPollingSupport: definition=/AUTOSAR/EcucDefs/CanIf/CanIfPublicCfg/CanIfPublicTxConfirmPollingSupport
          CanIfPublicVersionInfoApi: definition=/AUTOSAR/EcucDefs/CanIf/CanIfPublicCfg/CanIfPublicVersionInfoApi
          CanIfPublicIcomSupport: definition=/AUTOSAR/EcucDefs/CanIf/CanIfPublicCfg/CanIfPublicIcomSupport
          CanIfPublicTrcvPnEnable: definition=/AUTOSAR/EcucDefs/CanIf/CanIfPublicCfg/CanIfPublicTrcvPnEnable
        ecuc numerical param value CanIfPublicNumberOfCanHwUnits: definition=/AUTOSAR/EcucDefs/CanIf/CanIfPublicCfg/CanIfPublicNumberOfCanHwUnits, value=1
        ecuc numerical param value CanIfPublicNumberOfDynamicCanTxPduIds: definition=/AUTOSAR/EcucDefs/CanIf/CanIfPublicCfg/CanIfPublicNumberOfDynamicCanTxPduIds, value=0
        ecuc boolean param value CanIfPublicReadTxNotifStatusApi: definition=/AUTOSAR/EcucDefs/CanIf/CanIfPublicCfg/CanIfPublicReadTxNotifStatusApi, value=false
        ecuc boolean param value CanIfPublicReadRxNotifStatusApi: definition=/AUTOSAR/EcucDefs/CanIf/CanIfPublicCfg/CanIfPublicReadRxNotifStatusApi, value=false
        25 x ecuc numerical param value, all with value=0:
          CanIfCfgParam{1..25}: definition=/AUTOSAR/EcucDefs/CanIf/CanIfPublicCfg/CanIfCfgParam{1..25}
      CanIfInitCfg
        28 x ecuc numerical param value:
          CanIfMaxTrcvBaseAddr: definition=/AUTOSAR/EcucDefs/CanIf/CanIfInitCfg/CanIfMaxTrcvBaseAddr, value=0
          CanIfMaxBufferSize: definition=/AUTOSAR/EcucDefs/CanIf/CanIfInitCfg/CanIfMaxBufferSize, value=8
          CanIfMaxRxPduCfg: definition=/AUTOSAR/EcucDefs/CanIf/CanIfInitCfg/CanIfMaxRxPduCfg, value=64
          CanIfMaxTxPduCfg: definition=/AUTOSAR/EcucDefs/CanIf/CanIfInitCfg/CanIfMaxTxPduCfg, value=64
          CanIfCfgParam{26..49}: definition=/AUTOSAR/EcucDefs/CanIf/CanIfInitCfg/CanIfCfgParam{26..49}, value=0
        CanIfTxPduCfg
          ecuc numerical param value CanIfTxPduCanId: definition=/AUTOSAR/EcucDefs/CanIf/CanIfTxPduCfg/CanIfTxPduCanId, value=0
          ecuc numerical param value CanIfTxPduDlc: definition=/AUTOSAR/EcucDefs/CanIf/CanIfTxPduCfg/CanIfTxPduDlc, value=8
          ecuc reference value CanIfTxPduRef: definition=/AUTOSAR/EcucDefs/CanIf/CanIfTxPduCfg/CanIfTxPduRef
          ecuc enumeration param value CanIfTxPduType: definition=/AUTOSAR/EcucDefs/CanIf/CanIfTxPduCfg/CanIfTxPduType, value=STATIC
          ecuc enumeration param value CanIfTxPduCanIdType: definition=/AUTOSAR/EcucDefs/CanIf/CanIfTxPduCfg/CanIfTxPduCanIdType, value=STANDARD_CAN
          ecuc reference value CanIfTxPduBufferRef: definition=/AUTOSAR/EcucDefs/CanIf/CanIfTxPduCfg/CanIfTxPduBufferRef
          ecuc numerical param value CanIfTxPduId: definition=/AUTOSAR/EcucDefs/CanIf/CanIfTxPduCfg/CanIfTxPduId, value=0
          ecuc reference value CanIfTxPduCtrlRef: definition=/AUTOSAR/EcucDefs/CanIf/CanIfTxPduCfg/CanIfTxPduCtrlRef
          ecuc boolean param value CanIfTxPduTruncation: definition=/AUTOSAR/EcucDefs/CanIf/CanIfTxPduCfg/CanIfTxPduTruncation, value=false
          ecuc boolean param value CanIfTxPduReadNotifyStatus: definition=/AUTOSAR/EcucDefs/CanIf/CanIfTxPduCfg/CanIfTxPduReadNotifyStatus, value=false
          ecuc enumeration param value CanIfTxPduUserTxConfirmationUL: definition=/AUTOSAR/EcucDefs/CanIf/CanIfInitCfg/CanIfTxPduCfg/CanIfTxPduUserTxConfirmationUL, value=PDUR
          ecuc textual param value CanIfTxPduUserTxConfirmationName: definition=/AUTOSAR/EcucDefs/CanIf/CanIfInitCfg/CanIfTxPduCfg/CanIfTxPduUserTxConfirmationName
          ecuc boolean param value CanIfTxPduPnFilterPdu: definition=/AUTOSAR/EcucDefs/CanIf/CanIfInitCfg/CanIfTxPduCfg/CanIfTxPduPnFilterPdu, value=false
        CanIfCtrlCfg
          ecuc numerical param value CanIfCtrlId: definition=/AUTOSAR/EcucDefs/CanIf/CanIfCtrlCfg/CanIfCtrlId, value=0
          ecuc reference value CanIfCtrlCanCtrlRef: definition=/AUTOSAR/EcucDefs/CanIf/CanIfCtrlCfg/CanIfCtrlCanCtrlRef
          ecuc boolean param value CanIfCtrlWakeupSupport: definition=/AUTOSAR/EcucDefs/CanIf/CanIfCtrlCfg/CanIfCtrlWakeupSupport, value=false
          ecuc boolean param value CanIfCtrlPnEnabled: definition=/AUTOSAR/EcucDefs/CanIf/CanIfCtrlCfg/CanIfCtrlPnEnabled, value=false
          ecuc reference value CanIfCtrlWakeupSourceRef: definition=/AUTOSAR/EcucDefs/CanIf/CanIfInitCfg/CanIfCtrlCfg/CanIfCtrlWakeupSourceRef
