AUTOSAR XML
package /Multi
  i signal A: length=8, factor=1.0, offset=0.0
  i signal B: length=16, factor=1.0, offset=0.0
  i signal C: length=32, factor=1.0, offset=0.0
  pdu PduA: length=8
    mapping AMap0: i-signal=/Signals/A, start-position=0, packing-byte-order=little-endian
  can frame PduAFrame: frame-length=8, pdu-to-frame-mapping{pdu=/Pdus/PduA, start-position=0}
  frame PduAFrame: id 0x10
  pdu PduB: length=8
    mapping BMap0: i-signal=/Signals/B, start-position=0, packing-byte-order=little-endian
  can frame PduBFrame: frame-length=8, pdu-to-frame-mapping{pdu=/Pdus/PduB, start-position=0}
  frame PduBFrame: id 0x20
  pdu PduC: length=8
    mapping CMap0: i-signal=/Signals/C, start-position=0, packing-byte-order=little-endian
  can frame PduCFrame: frame-length=8, pdu-to-frame-mapping{pdu=/Pdus/PduC, start-position=0}
  frame PduCFrame: id 0x30
