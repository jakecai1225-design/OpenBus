AUTOSAR XML
package /BodyCan
  i signal SigA: length=8, factor=1.0, offset=0.0
  i signal SigB: length=16, factor=0.1, offset=0.0, unit=km/h
  pdu BodyCanPdu: length=8
    mapping SigAMap0: i-signal=/Signals/SigA, start-position=0, packing-byte-order=little-endian
    mapping SigBMap1: i-signal=/Signals/SigB, start-position=8, packing-byte-order=little-endian
  can frame BodyCanPduFrame: frame-length=8, pdu-to-frame-mapping{pdu=/Pdus/BodyCanPdu, start-position=0}
  frame BodyCanPduFrame: id 0x100
