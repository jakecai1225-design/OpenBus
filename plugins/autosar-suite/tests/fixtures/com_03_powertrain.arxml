AUTOSAR XML
package /Powertrain
  i signal SigA: length=8, factor=1.0, offset=0.0
  i signal SigB: length=16, factor=0.1, offset=0.0, unit=km/h
  pdu PowertrainPdu: length=8
    mapping SigAMap0: i-signal=/Signals/SigA, start-position=0, packing-byte-order=little-endian
    mapping SigBMap1: i-signal=/Signals/SigB, start-position=8, packing-byte-order=little-endian
  can frame PowertrainPduFrame: frame-length=8, pdu-to-frame-mapping{pdu=/Pdus/PowertrainPdu, start-position=0}
  frame PowertrainPduFrame: id 0x300
