AUTOSAR XML
package /DiagResp
  i signal SigA: length=8, factor=1.0, offset=0.0
  i signal SigB: length=16, factor=0.1, offset=0.0, unit=km/h
  pdu DiagRespPdu: length=8
    mapping SigAMap0: i-signal=/Signals/SigA, start-position=0, packing-byte-order=little-endian
    mapping SigBMap1: i-signal=/Signals/SigB, start-position=8, packing-byte-order=little-endian
  can frame DiagRespPduFrame: frame-length=8, pdu-to-frame-mapping{pdu=/Pdus/DiagRespPdu, start-position=0}
  frame DiagRespPduFrame: id 0x7E8
