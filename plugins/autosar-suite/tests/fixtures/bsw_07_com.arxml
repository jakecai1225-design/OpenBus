AUTOSAR XML
package /Ecuc_Com
  module config ActiveEcuC
    Com
      ComGeneral
        15 x ecuc boolean param value, all with value=false:
          ComConfigurationUseDet: definition=/AUTOSAR/EcucDefs/Com/ComGeneral/ComConfigurationUseDet
          ComRetryFailedTransmitRequests: definition=/AUTOSAR/EcucDefs/Com/ComGeneral/ComRetryFailedTransmitRequests
          ComEnableMDTForCyclicTransmission: definition=/AUTOSAR/EcucDefs/Com/ComGeneral/ComEnableMDTForCyclicTransmission
          ComVersionInfoApi: definition=/AUTOSAR/EcucDefs/Com/ComGeneral/ComVersionInfoApi
          ComMetaDataSupport: definition=/AUTOSAR/EcucDefs/Com/ComGeneral/ComMetaDataSupport
          ComEnableSignalGroupArrayApi: definition=/AUTOSAR/EcucDefs/Com/ComGeneral/ComEnableSignalGroupArrayApi
          ComSupportedIPduGroups: definition=/AUTOSAR/EcucDefs/Com/ComGeneral/ComSupportedIPduGroups
          ComUserCbkHeaderInclude: definition=/AUTOSAR/EcucDefs/Com/ComGeneral/ComUserCbkHeaderInclude
          ComEnableDynamicSignal: definition=/AUTOSAR/EcucDefs/Com/ComGeneral/ComEnableDynamicSignal
          ComCancellationSupport: definition=/AUTOSAR/EcucDefs/Com/ComGeneral/ComCancellationSupport
          ComEnableLargeDataTypes: definition=/AUTOSAR/EcucDefs/Com/ComGeneral/ComEnableLargeDataTypes
          ComProvideTxSignalId: definition=/AUTOSAR/EcucDefs/Com/ComGeneral/ComProvideTxSignalId
          ComProvideRxSignalId: definition=/AUTOSAR/EcucDefs/Com/ComGeneral/ComProvideRxSignalId
          ComProvideTxIpduId: definition=/AUTOSAR/EcucDefs/Com/ComGeneral/ComProvideTxIpduId
          ComProvideRxIpduId: definition=/AUTOSAR/EcucDefs/Com/ComGeneral/ComProvideRxIpduId
        ecuc numerical param value ComMaxIPduCnt: definition=/AUTOSAR/EcucDefs/Com/ComGeneral/ComMaxIPduCnt, value=256
        ecuc numerical param value ComMaxSignalCnt: definition=/AUTOSAR/EcucDefs/Com/ComGeneral/ComMaxSignalCnt, value=512
        ecuc numerical param value ComMaxSignalGroupCnt: definition=/AUTOSAR/EcucDefs/Com/ComGeneral/ComMaxSignalGroupCnt, value=64
        ecuc boolean param value ComDevErrorDetect: definition=/AUTOSAR/EcucDefs/Com/ComGeneral/ComDevErrorDetect, value=false
        ecuc textual param value ComUserCbkHeaderFile: definition=/AUTOSAR/EcucDefs/Com/ComGeneral/ComUserCbkHeaderFile
        ecuc boolean param value ComMultipartitionSupport: definition=/AUTOSAR/EcucDefs/Com/ComGeneral/ComMultipartitionSupport, value=false
        ecuc boolean param value ComGwInvalidateTx: definition=/AUTOSAR/EcucDefs/Com/ComGeneral/ComGwInvalidateTx, value=false
        ecuc textual param value ComPublicCddHeaderFile: definition=/AUTOSAR/EcucDefs/Com/ComGeneral/ComPublicCddHeaderFile
        30 x ecuc boolean param value, all with value=false:
          ComFeatureFlag{1..30}: definition=/AUTOSAR/EcucDefs/Com/ComGeneral/ComFeatureFlag{1..30}
      ComConfig
        ecuc numerical param value ComDataMemSize: definition=/AUTOSAR/EcucDefs/Com/ComConfig/ComDataMemSize, value=4096
        ecuc numerical param value ComMaxIPduCnt: definition=/AUTOSAR/EcucDefs/Com/ComConfig/ComMaxIPduCnt, value=64
        ecuc numerical param value ComTimeBase: definition=/AUTOSAR/EcucDefs/Com/ComConfig/ComTimeBase, value=10
        19 x ecuc boolean param value, all with value=false:
          ComFeatureFlag{31..49}: definition=/AUTOSAR/EcucDefs/Com/ComConfig/ComFeatureFlag{31..49}
        6 x ecuc numerical param value, all with value=0:
          ComConfigValue{1..6}: definition=/AUTOSAR/EcucDefs/Com/ComConfig/ComConfigValue{1..6}
        ComIPduGroup
          ecuc numerical param value ComIPduGroupHandleId: definition=/AUTOSAR/EcucDefs/Com/ComIPduGroup/ComIPduGroupHandleId, value=0
          ecuc reference value ComIPduGroupGroupRef: definition=/AUTOSAR/EcucDefs/Com/ComIPduGroup/ComIPduGroupGroupRef
          ecuc boolean param value ComIPduGroupReceptionEnable: definition=/AUTOSAR/EcucDefs/Com/ComIPduGroup/ComIPduGroupReceptionEnable, value=false
          ecuc boolean param value ComIPduGroupTransmissionEnable: definition=/AUTOSAR/EcucDefs/Com/ComIPduGroup/ComIPduGroupTransmissionEnable, value=false
          ecuc boolean param value ComStartIPduGroup: definition=/AUTOSAR/EcucDefs/Com/ComConfig/ComIPduGroup/ComStartIPduGroup, value=true
        ComIPdu
          ecuc enumeration param value ComIPduDirection: definition=/AUTOSAR/EcucDefs/Com/ComIPdu/ComIPduDirection, value=SEND
          ecuc enumeration param value ComIPduSignalProcessing: definition=/AUTOSAR/EcucDefs/Com/ComIPdu/ComIPduSignalProcessing, value=IMMEDIATE
          ecuc numerical param value ComIPduSize: definition=/AUTOSAR/EcucDefs/Com/ComIPdu/ComIPduSize, value=8
          ecuc reference value ComPduIdRef: definition=/AUTOSAR/EcucDefs/Com/ComIPdu/ComPduIdRef
          ecuc numerical param value ComIPduHandleId: definition=/AUTOSAR/EcucDefs/Com/ComIPdu/ComIPduHandleId, value=0
          ecuc enumeration param value ComIPduType: definition=/AUTOSAR/EcucDefs/Com/ComIPdu/ComIPduType, value=NORMAL
          ecuc boolean param value ComIPduCancellationSupport: definition=/AUTOSAR/EcucDefs/Com/ComIPdu/ComIPduCancellationSupport, value=false
          ecuc textual param value ComIPduCallout: definition=/AUTOSAR/EcucDefs/Com/ComIPdu/ComIPduCallout
          4 x ecuc numerical param value, all with value=0:
            ComIPduMinimumDelayTime: definition=/AUTOSAR/EcucDefs/Com/ComIPdu/ComIPduMinimumDelayTime
            ComTimeout: definition=/AUTOSAR/EcucDefs/Com/ComIPdu/ComTimeout
            ComIPduNumberOfRepetitions: definition=/AUTOSAR/EcucDefs/Com/ComIPdu/ComIPduNumberOfRepetitions
            ComIPduRepetitionPeriod: definition=/AUTOSAR/EcucDefs/Com/ComIPdu/ComIPduRepetitionPeriod
          ecuc reference value ComIPduGroupRef: definition=/AUTOSAR/EcucDefs/Com/ComIPdu/ComIPduGroupRef
          ecuc reference value ComIPduSignalGroupRef: definition=/AUTOSAR/EcucDefs/Com/ComIPdu/ComIPduSignalGroupRef
          ecuc boolean param value ComIPduDynamicSignal: definition=/AUTOSAR/EcucDefs/Com/ComIPdu/ComIPduDynamicSignal, value=false
          ecuc boolean param value ComIPduImmediateProcessing: definition=/AUTOSAR/EcucDefs/Com/ComIPdu/ComIPduImmediateProcessing, value=false
          ecuc boolean param value ComIPduTriggerTransmit: definition=/AUTOSAR/EcucDefs/Com/ComIPdu/ComIPduTriggerTransmit, value=false
          ecuc textual param value ComIPduTriggerTransmitCallout: definition=/AUTOSAR/EcucDefs/Com/ComConfig/ComIPdu/ComIPduTriggerTransmitCallout
          ecuc numerical param value ComIPduUnusedAreasDefault: definition=/AUTOSAR/EcucDefs/Com/ComConfig/ComIPdu/ComIPduUnusedAreasDefault, value=0
          ecuc boolean param value ComIPduReplicationEnabled: definition=/AUTOSAR/EcucDefs/Com/ComConfig/ComIPdu/ComIPduReplicationEnabled, value=false
          ecuc textual param value ComMetaDataDefault: definition=/AUTOSAR/EcucDefs/Com/ComConfig/ComIPdu/ComMetaDataDefault
          ecuc numerical param value ComTxIPduMinimumDelayFactor: definition=/AUTOSAR/EcucDefs/Com/ComConfig/ComIPdu/ComTxIPduMinimumDelayFactor, value=0
          ecuc enumeration param value ComTxIPduClearUpdateBit: definition=/AUTOSAR/EcucDefs/Com/ComConfig/ComIPdu/ComTxIPduClearUpdateBit, value=Transmit
          34 x ecuc numerical param value, all with value=0:
            ComTxIPduUnusedAreasDefault: definition=/AUTOSAR/EcucDefs/Com/ComConfig/ComIPdu/ComTxIPduUnusedAreasDefault
            ComConfigValue{7..39}: definition=/AUTOSAR/EcucDefs/Com/ComIPdu/ComConfigValue{7..39}
          ecuc reference value ComIPduSignalRef: definition=/AUTOSAR/EcucDefs/Com/ComIPdu/ComIPduSignalRef
          ecuc reference value ComTxModeTrueRef: definition=/AUTOSAR/EcucDefs/Com/ComIPdu/ComTxModeTrueRef
          ecuc reference value ComTxModeFalseRef: definition=/AUTOSAR/EcucDefs/Com/ComIPdu/ComTxModeFalseRef
          ecuc numerical param value ComIPduCounterThreshold: definition=/AUTOSAR/EcucDefs/Com/ComIPdu/ComIPduCounterThreshold, value=0
          ecuc numerical param value ComIPduCounterSize: definition=/AUTOSAR/EcucDefs/Com/ComIPdu/ComIPduCounterSize, value=0
          ecuc reference value ComGwMappingRef: definition=/AUTOSAR/EcucDefs/Com/ComIPdu/ComGwMappingRef
          ComTxMode
            ecuc enumeration param value ComTxModeMode: definition=/AUTOSAR/EcucDefs/Com/ComTxMode/ComTxModeMode, value=PERIODIC
            4 x ecuc numerical param value:
              ComTxModeNumberOfRepetitions: definition=/AUTOSAR/EcucDefs/Com/ComTxMode/ComTxModeNumberOfRepetitions, value=0
              ComTxModeTimePeriod: definition=/AUTOSAR/EcucDefs/Com/ComTxMode/ComTxModeTimePeriod, value=0.1
              ComTxModeTimeOffset: definition=/AUTOSAR/EcucDefs/Com/ComTxMode/ComTxModeTimeOffset, value=0
              ComTxModeRepetitionPeriod: definition=/AUTOSAR/EcucDefs/Com/ComTxMode/ComTxModeRepetitionPeriod, value=0
        ComMainFunctionTx
          ecuc numerical param value ComMainFunctionPeriod: definition=/AUTOSAR/EcucDefs/Com/ComMainFunctionTx/ComMainFunctionPeriod, value=0.01
        ComMainFunctionRx
          ecuc numerical param value ComMainFunctionPeriod: definition=/AUTOSAR/EcucDefs/Com/ComMainFunctionRx/ComMainFunctionPeriod, value=0.01
