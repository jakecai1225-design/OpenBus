AUTOSAR XML
package /Ecuc_Os
  module config ActiveEcuC
    Os
      OsAppMode
        ecuc numerical param value OsAppModeId: definition=/AUTOSAR/EcucDefs/Os/OsAppMode/OsAppModeId, value=0
        ecuc boolean param value OsAppModeAutostart: definition=/AUTOSAR/EcucDefs/Os/OsAppMode/OsAppModeAutostart, value=false
      OsTask
        ecuc numerical param value OsTaskPriority: definition=/AUTOSAR/EcucDefs/Os/OsTask/OsTaskPriority, value=10
        ecuc enumeration param value OsTaskSchedule: definition=/AUTOSAR/EcucDefs/Os/OsTask/OsTaskSchedule, value=FULL
        ecuc numerical param value OsTaskActivation: definition=/AUTOSAR/EcucDefs/Os/OsTask/OsTaskActivation, value=1
        ecuc numerical param value OsTaskStackSize: definition=/AUTOSAR/EcucDefs/Os/OsTask/OsTaskStackSize, value=1024
        ecuc enumeration param value OsTaskType: definition=/AUTOSAR/EcucDefs/Os/OsTask/OsTaskType, value=BASIC
        ecuc boolean param value OsTaskAutostart: definition=/AUTOSAR/EcucDefs/Os/OsTask/OsTaskAutostart, value=false
        ecuc textual param value OsTaskAccessingApplication: definition=/AUTOSAR/EcucDefs/Os/OsTask/OsTaskAccessingApplication
        ecuc textual param value OsTaskEntry: definition=/AUTOSAR/EcucDefs/Os/OsTask/OsTaskEntry
        ecuc reference value OsTaskEventRef: definition=/AUTOSAR/EcucDefs/Os/OsTask/OsTaskEventRef
        ecuc reference value OsTaskResourceRef: definition=/AUTOSAR/EcucDefs/Os/OsTask/OsTaskResourceRef
      OsOS
        5 x ecuc boolean param value, all with value=false:
          OsStackMonitoring: definition=/AUTOSAR/EcucDefs/Os/OsOS/OsStackMonitoring
          OsStatus: definition=/AUTOSAR/EcucDefs/Os/OsOS/OsStatus
          OsUseGetServiceId: definition=/AUTOSAR/EcucDefs/Os/OsOS/OsUseGetServiceId
          OsUseParameterAccess: definition=/AUTOSAR/EcucDefs/Os/OsOS/OsUseParameterAccess
          OsUseResScheduler: definition=/AUTOSAR/EcucDefs/Os/OsOS/OsUseResScheduler
        ecuc enumeration param value OsScalabilityClass: definition=/AUTOSAR/EcucDefs/Os/OsOS/OsScalabilityClass, value=SC1
