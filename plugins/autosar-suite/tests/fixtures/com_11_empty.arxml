AUTOSAR XML
package /EmptyPkg
  i signal DemoSignal: length=16, factor=1.0, offset=0.0
  pdu DemoPdu: length=8
    mapping DemoSignalMap0: i-signal=/Signals/DemoSignal, start-position=0, packing-byte-order=little-endian
  can frame DemoPduFrame: frame-length=8, pdu-to-frame-mapping{pdu=/Pdus/DemoPdu, start-position=0}
  frame DemoPduFrame: id 0x100
