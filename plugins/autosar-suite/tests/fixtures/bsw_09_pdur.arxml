AUTOSAR XML
package /Ecuc_PduR
  module config ActiveEcuC
    PduR
      PduRGeneral
        6 x ecuc boolean param value, all with value=false:
          PduRDevErrorDetect: definition=/AUTOSAR/EcucDefs/PduR/PduRGeneral/PduRDevErrorDetect
          PduRVersionInfoApi: definition=/AUTOSAR/EcucDefs/PduR/PduRGeneral/PduRVersionInfoApi
          PduRZeroCostOperation: definition=/AUTOSAR/EcucDefs/PduR/PduRGeneral/PduRZeroCostOperation
          PduRMetaDataSupport: definition=/AUTOSAR/EcucDefs/PduR/PduRGeneral/PduRMetaDataSupport
          PduRMulticastSupport: definition=/AUTOSAR/EcucDefs/PduR/PduRGeneral/PduRMulticastSupport
          PduRRoutingPathGroupSupport: definition=/AUTOSAR/EcucDefs/PduR/PduRGeneral/PduRRoutingPathGroupSupport
      PduRRoutingTables
        ecuc numerical param value PduRMaxRoutingTableEntries: definition=/AUTOSAR/EcucDefs/PduR/PduRRoutingTables/PduRMaxRoutingTableEntries, value=16
        PduRRoutingTable
          ecuc reference value PduRSrcPduRef: definition=/AUTOSAR/EcucDefs/PduR/PduRRoutingTable/PduRSrcPduRef
          ecuc reference value PduRDestPduRef: definition=/AUTOSAR/EcucDefs/PduR/PduRRoutingTable/PduRDestPduRef
          ecuc enumeration param value PduRDestPduDataProvision: definition=/AUTOSAR/EcucDefs/PduR/PduRRoutingTable/PduRDestPduDataProvision, value=DIRECT
          ecuc textual param value PduRRoutingPathGroupRef: definition=/AUTOSAR/EcucDefs/PduR/PduRRoutingTable/PduRRoutingPathGroupRef
          ecuc numerical param value PduRQueueDepth: definition=/AUTOSAR/EcucDefs/PduR/PduRRoutingTable/PduRQueueDepth, value=0
          PduRDestPdu
            ecuc numerical param value PduRDestPduHandleId: definition=/AUTOSAR/EcucDefs/PduR/PduRDestPdu/PduRDestPduHandleId, value=0
            ecuc reference value PduRDestPduRef: definition=/AUTOSAR/EcucDefs/PduR/PduRDestPdu/PduRDestPduRef
            ecuc boolean param value PduRTransmissionConfirmation: definition=/AUTOSAR/EcucDefs/PduR/PduRDestPdu/PduRTransmissionConfirmation, value=false
            ecuc enumeration param value PduRDestPduDataProvision: definition=/AUTOSAR/EcucDefs/PduR/PduRDestPdu/PduRDestPduDataProvision, value=TRIGGER_TRANSMIT
          PduRSrcPdu
            ecuc numerical param value PduRSourcePduHandleId: definition=/AUTOSAR/EcucDefs/PduR/PduRSrcPdu/PduRSourcePduHandleId, value=0
            ecuc reference value PduRSrcPduRef: definition=/AUTOSAR/EcucDefs/PduR/PduRSrcPdu/PduRSrcPduRef
            ecuc textual param value PduRSourcePduPduRBswModulesRef: definition=/AUTOSAR/EcucDefs/PduR/PduRSrcPdu/PduRSourcePduPduRBswModulesRef, value=Com
      PduRConfiguration
        PduRRoutingPath
          ecuc reference value PduRSrcPduRef: definition=/AUTOSAR/EcucDefs/PduR/PduRRoutingPath/PduRSrcPduRef
          ecuc reference value PduRDestPduRef: definition=/AUTOSAR/EcucDefs/PduR/PduRRoutingPath/PduRDestPduRef
          ecuc enumeration param value PduRDestPduDataProvision: definition=/AUTOSAR/EcucDefs/PduR/PduRRoutingPath/PduRDestPduDataProvision, value=PDUR_DIRECT
          ecuc boolean param value PduRTransmissionConfirmation: definition=/AUTOSAR/EcucDefs/PduR/PduRRoutingPath/PduRTransmissionConfirmation, value=false
          ecuc boolean param value PduRTpThresholdReached: definition=/AUTOSAR/EcucDefs/PduR/PduRRoutingPath/PduRTpThresholdReached, value=false
          ecuc numerical param value PduRQueueLength: definition=/AUTOSAR/EcucDefs/PduR/PduRConfiguration/PduRRoutingPath/PduRQueueLength, value=0
