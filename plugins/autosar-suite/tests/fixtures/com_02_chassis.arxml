AUTOSAR XML
package /Chassis
  i signal SigA: length=8, factor=1.0, offset=0.0
  i signal SigB: length=16, factor=0.1, offset=0.0, unit=km/h
  pdu ChassisPdu: length=8
    mapping SigAMap0: i-signal=/Signals/SigA, start-position=0, packing-byte-order=little-endian
    mapping SigBMap1: i-signal=/Signals/SigB, start-position=8, packing-byte-order=little-endian
  can frame ChassisPduFrame: frame-length=8, pdu-to-frame-mapping{pdu=/Pdus/ChassisPdu, start-position=0}
  frame ChassisPduFrame: id 0x200
